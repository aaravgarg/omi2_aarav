## test/build/build_OMI2_test/ipc_radio/Kconfig/Kconfig.shield
```kconfig
osource "/Users/aaravgarg/Coding/omi2_aarav/boards/shields/*/Kconfig.shield"
osource "/opt/nordic/ncs/v2.9.1/nrf/boards/shields/*/Kconfig.shield"
```

## test/build/build_OMI2_test_1/Kconfig/boards/Kconfig
```kconfig
# Load Zephyr board Kconfig descriptions.
osource "/Users/aaravgarg/Coding/omi2_aarav/boards/omi_nrf5340/omi_nrf5340/Kconfig"
```

## test/build/build_OMI2_test_1/ipc_radio/Kconfig/boards/Kconfig.defconfig
```kconfig
# Load Zephyr board defconfig descriptions.
osource "/Users/aaravgarg/Coding/omi2_aarav/boards/omi_nrf5340/omi_nrf5340/Kconfig.defconfig"
```

## test/build/build_OMI2_test_2/test/Kconfig/Kconfig.shield.defconfig
```kconfig
osource "/Users/aaravgarg/Coding/omi2_aarav/boards/shields/*/Kconfig.defconfig"
osource "/opt/nordic/ncs/v2.9.1/nrf/boards/shields/*/Kconfig.defconfig"
```
